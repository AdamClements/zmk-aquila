/*
 * Copyright (c) 2020 The ZMK Contributors
 *
 * SPDX-License-Identifier: MIT
 */

#include "aquila.dtsi"

/* This left half carries the OLED on the accessory connector, not an
 * encoder — the EC11 devices would read i2c traffic as phantom
 * rotations if left enabled. */
&encoder_1 {
	status = "disabled";
};

&encoder_2 {
	status = "disabled";
};

/* This OLED module needs longer VCC settle time before it will ACK i2c;
 * the board default of 50ms is not enough (2022-era firmware, which had
 * a much lazier boot, worked; every modern build failed init). */
&{/EXT_POWER} {
	init-delay-ms = <500>;
};
